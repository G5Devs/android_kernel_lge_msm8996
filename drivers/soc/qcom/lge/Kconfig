## drivers/soc/qcom/lge/Kconfig
```kconfig
config MACH_LGE
	bool "Machine LGE"
	help
	  Support for machine LGE.


menu "LGE Board Selection"

config MACH_MSM8996_H1
	bool "MSM8996 H1"
	depends on ARCH_MSM8996
	select MACH_LGE
	select LGE_DDR_SECTION_SIZE_CHANGE
	help
	  Support for the Qualcomm MSM8996 H1 device.
endmenu

menu "LGE Specific Patches"

config LGE_PM_DEBUG
        tristate "Support LGE PM Debug Feature"
        default n
        depends on MACH_LGE
        help
	  LGE PM Debug Feature

config LGE_PM_CABLE_DETECTION
	tristate "Support LGE PM Cable Detection"
	default n
	depends on MACH_LGE
	help
	  LGE PM Cable Detection

config LGE_PM_SMPL_COUNTER
	tristate "Support LGE SMPL COUNTER feature"
	default n
	depends on MACH_LGE
	help
	  Say y to enable smpl_cnt module, that count when
	  booted by SMPL

config LGE_PM_CHARGING_CONTROLLER
	tristate "LGE Charging controller"
	default n
	depends on MACH_LGE
	help
	  enable the LGE Charging controller

config LGE_PM_CHARGING_SCENARIO
	tristate "Support LGE PM Charging Scenario"
	default n
	depends on MACH_LGE
	help
	  LGE PM Charging Scenario

config LGE_PM_UNIFIED_NODE
	bool "enable LGE PM Unified sysfs node"
	default n
	depends on MACH_LGE
	help
	  Support LGE PM Unified sysfs node

config LGE_PM_PSEUDO_BATTERY
	tristate "Support pseudo battery mode"
	depends on MACH_LGE
	default n
	help
	  Say Y here to enable pseudo mode setting

endmenu
```
